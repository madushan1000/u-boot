## configs/ox64_m0_defconfig
```kconfig
CONFIG_RISCV=y
CONFIG_SYS_MALLOC_LEN=0x10000
CONFIG_NR_DRAM_BANKS=1
CONFIG_ENV_SIZE=0x1000
CONFIG_DEFAULT_DEVICE_TREE="bl808-m0-ox64"
CONFIG_DM_RESET=y
CONFIG_TARGET_BFLB_BL808=y
CONFIG_XIP=y
# CONFIG_SYS_MALLOC_CLEAR_ON_INIT is not set
CONFIG_REMAKE_ELF=y
# CONFIG_BOOTSTD is not set
# CONFIG_LEGACY_IMAGE_FORMAT is not set
CONFIG_SUPPORT_RAW_INITRD=y
CONFIG_DYNAMIC_SYS_CLK_FREQ=y
# CONFIG_ARCH_FIXUP_FDT_MEMORY is not set
# CONFIG_AUTOBOOT is not set
CONFIG_HUSH_PARSER=y
# CONFIG_CMD_BDI is not set
# CONFIG_CMD_CONSOLE is not set
# CONFIG_CMD_CPU is not set
# CONFIG_CMD_BOOTD is not set
# CONFIG_CMD_BOOTM is not set
# CONFIG_CMD_ELF is not set
# CONFIG_CMD_FDT is not set
# CONFIG_CMD_IMI is not set
# CONFIG_CMD_XIMG is not set
# CONFIG_CMD_EXPORTENV is not set
# CONFIG_CMD_IMPORTENV is not set
# CONFIG_CMD_EDITENV is not set
# CONFIG_CMD_SAVEENV is not set
# CONFIG_CMD_ENV_EXISTS is not set
# CONFIG_CMD_LZMADEC is not set
# CONFIG_CMD_UNLZ4 is not set
# CONFIG_CMD_UNZIP is not set
CONFIG_CMD_CLK=y
CONFIG_CMD_GPIO=y
CONFIG_CMD_MMC=y
CONFIG_CMD_REMOTEPROC=y
CONFIG_CMD_DHCP=n
CONFIG_CMD_FS_GENERIC=y
CONFIG_DOS_PARTITION=y
CONFIG_EFI_PARTITION=y
CONFIG_NET_RANDOM_ETHADDR=n
# CONFIG_DM_STDIO is not set
# CONFIG_I2C is not set
# CONFIG_INPUT is not set
CONFIG_MMC=y
CONFIG_MMC_BROKEN_CD=y
CONFIG_MMC_SDHCI=y
CONFIG_MMC_SDHCI_BFLB=y
# CONFIG_MTD is not set
CONFIG_SPI_FLASH_WINBOND=y
CONFIG_ETHOC=y
CONFIG_PINCTRL=y
# CONFIG_PINCONF_RECURSIVE is not set
# CONFIG_POWER is not set
CONFIG_RAM=y
# CONFIG_RAM_SIFIVE is not set
CONFIG_REMOTEPROC_BFLB=y
CONFIG_SPI=y
CONFIG_SYSRESET=y
CONFIG_FS_EXT4=y
CONFIG_FS_FAT=n
# CONFIG_GZIP is not set
# CONFIG_EFI_LOADER is not set


#additions

CONFIG_PHY=y
CONFIG_BL808_USB_PHY=y

CONFIG_USB=y
CONFIG_DM_USB_GADGET=y

CONFIG_USB_GADGET=y
CONFIG_USB_GADGET_MANUFACTURER="BL808"
CONFIG_USB_GADGET_VENDOR_NUM=0x18d1
CONFIG_USB_GADGET_PRODUCT_NUM=0x4e40

CONFIG_USB_FUNCTION_FASTBOOT=y
CONFIG_FASTBOOT_BUF_ADDR=0x51000000
CONFIG_FASTBOOT_BUF_SIZE=0x4000000
CONFIG_FASTBOOT_USB_DEV=1
CONFIG_FASTBOOT_FLASH=y
CONFIG_FASTBOOT_FLASH_MMC_DEV=1
CONFIG_FASTBOOT_CMD_OEM_FORMAT=y
CONFIG_FASTBOOT_OEM_RUN=y
CONFIG_FASTBOOT_UUU_SUPPORT=y

CONFIG_CMD_BOOTM=y
CONFIG_LMB=y
CONFIG_BOOTM_LINUX=y
CONFIG_SYS_BOOTM_LEN=0x2000000

CONFIG_USB_GADGET_FOTG210=y
CONFIG_USB_GADGET_FOTG210_VDMA=y

CONFIG_LOG_MAX_LEVEL=7
CONFIG_LOG_DEFAULT_LEVEL=7
CONFIG_CMD_BDI=y

CONFIG_CMD_USB_MASS_STORAGE=n
CONFIG_USB_FUNCTION_MASS_STORAGE=n

CONFIG_USB_GADGET_DUALSPEED=y

CONFIG_AUTOBOOT=y
CONFIG_USE_BOOTCOMMAND=y
CONFIG_BOOTCOMMAND="fastboot 0"

CONFIG_NETDEVICES=n
CONFIG_CMD_NET=n

CONFIG_CMD_CACHE=y
```
